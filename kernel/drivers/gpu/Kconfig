## kernel/drivers/huawei/drivers/touchscreen/cypress/Kconfig
```kconfig
#
# Cypress Touchscreen driver configuration
#
config CYPRESS_CYTTSP4_BUS
	bool "Cypress TTSP core bus"
	default y
	help
	  This option enables support Cypress TTSP core bus.
	  This support is needed for various device and drivers
	  using Cypress TrueTouch(TM) Standard Product
	  protocol.

config TOUCHSCREEN_CYPRESS_CYTTSP4
	tristate "Cypress TrueTouch Gen4 Touchscreen Driver"
	default y
	select CYPRESS_CYTTSP4_BUS
	select TOUCHSCREEN_CYPRESS_CYTTSP4_I2C
	select TOUCHSCREEN_CYPRESS_CYTTSP4_MT_B
	help
	  Core driver for Cypress TrueTouch(tm) Standard Product
	  Geneartion4 touchscreen controllers.

	  Say Y here if you have a Cypress Gen4 touchscreen.

	  If unsure, say N.

	  To compile this driver as a module, choose M here.

config TOUCHSCREEN_CYPRESS_CYTTSP4_INCLUDE_FW
	bool "FW upgrade from header file"
	depends on TOUCHSCREEN_CYPRESS_CYTTSP4
	default n
	help
	  Include Cypress TrueTouch(tm) Standard Product
	  Generation4 device Firmware into driver.

	  Need proper header file for this.

config TOUCHSCREEN_CYPRESS_CYTTSP4_USE_FW_BIN_FILE
	bool "FW upgrade from binary file"
	depends on TOUCHSCREEN_CYPRESS_CYTTSP4
	default y
	help
	  Include Cypress TrueTouch(tm) Standard Product
	  Generation4 device Firmware into kernel itself.

	  This should be enabled for manual FW upgrade.

config TOUCHSCREEN_CYPRESS_CYTTSP4_AUTO_LOAD_TOUCH_PARAMS
	bool "Auto FW upgrade if TT Configuration modified"
	depends on TOUCHSCREEN_CYPRESS_CYTTSP4
	default y
	help
	  Does Cypress TrueTouch(tm) Standard Product
	  Generation4 device Firmware TrueTouch Configuration
	  check. If configuration updated, does a Firmware
	  upgrade.

	  Need proper header file for this.

config TOUCHSCREEN_CYPRESS_CYTTSP4_DEBUG
	bool "Enable debug output"
	depends on TOUCHSCREEN_CYPRESS_CYTTSP4
	default n
	help
	  Enable Debug output for Cypress TrueTouch(tm)
	  Standard Product Generation4 drivers set.

	  Say Y here to enable debug output.

config TOUCHSCREEN_CYPRESS_CYTTSP4_VDEBUG
	bool "Enable verbose debug output"
	depends on TOUCHSCREEN_CYPRESS_CYTTSP4_DEBUG
	default n
	help
	  Enable Verbose Debug output for Cypress TrueTouch(tm)
	  Standard Product Generation4 drivers set.

	  Say Y here to enable verbose debug output.

config TOUCHSCREEN_CYPRESS_CYTTSP4_I2C
	tristate "Cypress TrueTouch Gen4 I2C"
	depends on TOUCHSCREEN_CYPRESS_CYTTSP4
	select I2C
	default y
	help
	  Cypress TrueTouch(tm) Standard Product Generation4
	  I2C bus interface.

	  Say Y here to enable I2C bus interface to TTSP
	  touchscreen controller.

config TOUCHSCREEN_CYPRESS_CYTTSP4_SPI
	tristate "Cypress TrueTouch Gen4 SPI"
	depends on TOUCHSCREEN_CYPRESS_CYTTSP4
	select SPI
	default m
	help
	  Cypress TrueTouch(tm) Standard Product Generation4
	  SPI bus interface.

	  Say Y here to enable SPI bus interface to TTSP
	  touchscreen controller.

config TOUCHSCREEN_CYPRESS_CYTTSP4_MT_A
	tristate "Cypress TrueTouch Gen4 MultiTouch Protocol A"
	depends on TOUCHSCREEN_CYPRESS_CYTTSP4
	default m
	help
	  Cypress TrueTouch(tm) Standard Product Generation4
	  MutliTouch Protocol A support.

	  Say Y here to enable MutiTouch touch reporting
	  using protocol A.

config TOUCHSCREEN_CYPRESS_CYTTSP4_MT_B
	tristate "Cypress TrueTouch Gen4 MultiTouch Protocol B"
	depends on TOUCHSCREEN_CYPRESS_CYTTSP4
	default y
	help
	  Cypress TrueTouch(tm) Standard Product Generation4
	  MutliTouch Protocol B support.

	  Say Y here to enable MutiTouch touch reporting
	  using protocol B.

config TOUCHSCREEN_CYPRESS_CYTTSP4_BUTTON
	tristate "Cypress TrueTouch Gen4 MultiTouch CapSense Button"
	depends on TOUCHSCREEN_CYPRESS_CYTTSP4
	default m
	help
	  Cypress TrueTouch(tm) Standard Product Generation4
	  CapSense driver.

	  Say Y here to enable CapSense reporting.

config TOUCHSCREEN_CYPRESS_CYTTSP4_DEVICE_ACCESS
	tristate "Cypress TrueTouch Gen4 MultiTouch Device Access"
	depends on TOUCHSCREEN_CYPRESS_CYTTSP4
	default y
	help
	  Cypress TrueTouch(tm) Standard Product Generation4
	  Device access module.

	  This modules adds an interface to access touchscreen
	  controller using driver sysfs nodes.

config TOUCHSCREEN_CYPRESS_CYTTSP4_LOADER
	tristate "Cypress TrueTouch Gen4 MultiTouch Loader"
	depends on TOUCHSCREEN_CYPRESS_CYTTSP4
	default y
	help
	  Cypress TrueTouch(tm) Standard Product Generation4
	  FW Loader module.

	  This module enables support for Firmware upgrade.

config TOUCHSCREEN_CYPRESS_CYTTSP4_MANUAL_TTCONFIG_UPGRADE
	bool "TT Configuration upgrade via SysFs"
	depends on TOUCHSCREEN_CYPRESS_CYTTSP4_LOADER
	default n
	help
	  Provides a SysFs interface to upgrade TrueTouch
	  Configuration with a binary configuration file.

config TOUCHSCREEN_CYPRESS_CYTTSP4_DEBUG_MODULE
	tristate "Cypress TrueTouch Gen4 MultiTouch Debug Module"
	depends on TOUCHSCREEN_CYPRESS_CYTTSP4
	default n
	help
	  Cypress TrueTouch(tm) Standard Product Generation4
	  Debug module.

	  This module adds support for verbose printing touch
	  information.
```
