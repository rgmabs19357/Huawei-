## kernel/drivers/gpu/Kconfig
```kconfig
config MALI_DEVICE 
	bool "mali device"
	help

source "drivers/gpu/mali/Kconfig"
source "drivers/gpu/ump/Kconfig"
```

## kernel/drivers/hi6620/8290enc/Kconfig
```kconfig
menu "8290 encode support"

config 8290_ENC
    tristate "Support for hisi k3 video encode processor"
    help
        The encode device provides decode function for H.264/JPEG

config 8290_ENC_CLK
    int "8290 Encode Clock Frequence"
    default "280000000"
    help
        Set default 8290 encode clock frequence

config 8290_ENC_WAIT_TIMEOUT_COEFF
    int "8290 encode wait timeout coefficient"
    default "1"
    help
        Set default 8290 encode wait timeout coefficient

endmenu
```

## kernel/drivers/hi6620/Kconfig
```kconfig
menu "HI6620 support drivers"
source "drivers/hi6620/g1dec/Kconfig"
source "drivers/hi6620/8290enc/Kconfig"
endmenu
```

## kernel/drivers/hi6620/g1dec/Kconfig
```kconfig
menu "g1 decode support"

config G1_DEC
    tristate "Support for hisi k3 video dec processor"
    help
        The decode device provides decode function for H.264/MPEG4/VC1

config G1_DEC_CLK
    int "G1 Decode Clock Frequence"
    default "200000000"
    help
        Set default g1 decode clock frequence

config G1_DEC_WAIT_TIMEOUT_COEFF
    int "G1 decode wait timeout coefficient"
    default "1"
    help
        Set default g1 decode wait timeout coefficient

endmenu
```

## kernel/drivers/hik3/8290enc/Kconfig
```kconfig
menu "8290 encode support"

config 8290_ENC
    tristate "Support for hisi k3 video encode processor"
    help
        The encode device provides decode function for H.264/JPEG
endmenu
```

## kernel/drivers/hisi/Kconfig
```kconfig
menu "hisi balong support driver"
config HISI
     bool "hisi drv module"
     help
          hisi drv module.

source "drivers/hisi/test/Kconfig"
source "drivers/hisi/hifidsp/Kconfig"

endmenu
```

## kernel/drivers/hisi/hifidsp/Kconfig
```kconfig
menu "Hifimisc driver serve HIFI dsp"

config SND_HIFI_LPP
     bool "hifi low power play device support"
     help
          hifi lpp device provide service for HIFI and AP, in case of HIFI ultra-low power audio play.

endmenu
```

## kernel/drivers/hisi/test/Kconfig
```kconfig
menu "hisi balong support driver - test"
config HISI_TEST
     bool "hisi test module"
     help
          hisi test module.
endmenu
```

## kernel/drivers/huawei/Kconfig
```kconfig
menuconfig HUAWEI_DEVICE
	bool "HUAWEI terminal device support"
	default y
	---help---
		Say yes if you want to enable support for HUAWEI terminal devices.

if HUAWEI_DEVICE
source "drivers/huawei/drivers/Kconfig"
endif
```

## kernel/drivers/huawei/drivers/Kconfig
```kconfig
menu "Audio device drivers"
#source "drivers/huawei/drivers/audio/Kconfig"
endmenu

menu "Camera sensor device drivers"
source "drivers/huawei/drivers/camera/Kconfig"
endmenu

menu "Connectivity device drivers"
source "drivers/huawei/drivers/connectivity/Kconfig"
endmenu

#source "drivers/huawei/drivers/keypad/Kconfig"

menu "LCD device drivers"
source "drivers/huawei/drivers/lcd_panel/Kconfig"
endmenu

menu "LED device drivers"
source "drivers/huawei/drivers/led/Kconfig"
endmenu

menu "Misc device drivers"
#source "drivers/huawei/drivers/misc/Kconfig"
endmenu

source "drivers/huawei/drivers/modem/Kconfig"

menu "Power supply device drivers"
source "drivers/huawei/drivers/power/Kconfig"
endmenu

menu "Sensor device drivers"
source "drivers/huawei/drivers/sensor/Kconfig"
endmenu

#source "drivers/huawei/drivers/thermal/Kconfig"

menu "Touchscreen device drivers"
source "drivers/huawei/drivers/touchscreen/Kconfig"
endmenu

#source "drivers/huawei/drivers/video/Kconfig"

source "drivers/huawei/drivers/tfa9887/Kconfig"

source "drivers/huawei/drivers/audience/Kconfig"

source "drivers/huawei/drivers/modemctl/Kconfig"

source "drivers/huawei/drivers/simcard_switch/Kconfig"

source "drivers/huawei/drivers/hw_kstate/Kconfig"

source "drivers/huawei/drivers/dsm/Kconfig"
```

## kernel/drivers/huawei/drivers/camera/Kconfig
```kconfig
config HI6620_CAMERA_FLASH
	tristate "Hisilicon K3 flash"
	depends on VIDEO_HI6620_CAMERA && VIDEO_HIK3_ISP_CAMERA
	default n
	---help---
	Hisilicon K3 flash driver
	

config HI6620_CAMERA_FLASH_LM3642
	tristate "lm3642 flash"
	depends on VIDEO_HI6620_CAMERA && VIDEO_HIK3_ISP_CAMERA && HI6620_CAMERA_FLASH
	default n
	---help---
	Hisilicon K3 flash driver
	

config HI6620_CAMERA_FLASH_TPS61310
	tristate "tps61310 flash"
	depends on VIDEO_HI6620_CAMERA && VIDEO_HIK3_ISP_CAMERA && HI6620_CAMERA_FLASH
	default n
	---help---
	Hisilicon K3 flash driver


config HI6620_CAMERA_HI542
    tristate "HI542 camera"
    depends on VIDEO_HI6620_CAMERA && VIDEO_HIK3_ISP_CAMERA
    default n
    ---help---
        HI542 camera driver

config HI6620_CAMERA_S5K4E1GA_FOXCONN
    tristate "S5K4E1GA_FOXCONN camera"
    depends on VIDEO_HI6620_CAMERA && VIDEO_HIK3_ISP_CAMERA
    default n
    ---help---
        S5K4E1GA_FOXCONN camera driver

config HI6620_CAMERA_SONYIMX134
    tristate "SONYIMX134 camera"
    depends on VIDEO_HI6620_CAMERA && VIDEO_HIK3_ISP_CAMERA
    default n
    ---help---
        HiSONYIMX134 camera driver

config HI6620_CAMERA_SONYIMX135
    tristate "SONYIMX135 camera"
    depends on VIDEO_HI6620_CAMERA && VIDEO_HIK3_ISP_CAMERA
    default n
    ---help---
        HiSONYIMX135 camera driver

config HI6620_CAMERA_SONYIMX214
    tristate "SONYIMX214 camera"
    depends on VIDEO_HI6620_CAMERA && VIDEO_HIK3_ISP_CAMERA
    default n
    ---help---
        HiSONYIMX214 camera driver

config HI6620_CAMERA_OV5648_FOXCONN
    tristate "OV5648_foxconn camera"
    depends on VIDEO_HI6620_CAMERA && VIDEO_HIK3_ISP_CAMERA
    default n
    ---help---
        OV5648_FOXCONN camera driver

config HI6620_CAMERA_OV5648_SUNNY
    tristate "OV5648_sunny camera"
    depends on VIDEO_HI6620_CAMERA && VIDEO_HIK3_ISP_CAMERA
    default n
    ---help---
        OV5648_SUNNY camera driver
config HI6620_CAMERA_S5K4E1GX_FOXCONN
    tristate "S5K4E1GX_FOXCONN camera"
    depends on VIDEO_HI6620_CAMERA && VIDEO_HIK3_ISP_CAMERA
    default n
    ---help---
        S5K4E1GX_FOXCONN camera driver

config HI6620_CAMERA_SONYIMX179
    tristate "SONYIMX179 camera"
    depends on VIDEO_HI6620_CAMERA && VIDEO_HIK3_ISP_CAMERA
    default n
    ---help---
        HiSONYIMX179 camera driver

source "drivers/huawei/drivers/camera/flash/Kconfig"
```

## kernel/drivers/huawei/drivers/camera/flash/Kconfig
```kconfig
#
# Flash Thermal protect configuration
#

config FLASH_THERMAL_PROTECT
	bool "hi6620 flash thermal protect"
	default y
	help
	  close flash when the temperature is too high one time.

config FLASH_THERMAL_PROTECT_CONTINUE
	bool "hi6620 flash thermal protect continuely"
	depends on FLASH_THERMAL_PROTECT
	help
	  close flash when the temperature is too high continuely.
```

## kernel/drivers/huawei/drivers/connectivity/Kconfig
```kconfig
menu "Bluetooth device drivers"
source "drivers/huawei/drivers/connectivity/bluetooth/Kconfig"
endmenu


menu "wi-Fi device drivers"
source "drivers/huawei/drivers/connectivity/wifi/Kconfig"

endmenu

menu "GPS device drivers"
source "drivers/huawei/drivers/connectivity/gps/Kconfig"
endmenu

menu "NFC device drivers"
source "drivers/huawei/drivers/connectivity/nfc/Kconfig"
endmenu
```

## kernel/drivers/huawei/drivers/connectivity/bluetooth/Kconfig
```kconfig
menu "BLUETOOTH BCM4334 Driver"   
                                             
comment "BLUETOOTH BCM4334 Driver"

config BT_SLEEP
	tristate "BCM4334 Bluesleep driver"
	depends on BT_HCIUART
	default y
	help
	  BCM4334 bluesleep driver.
	  This driver provides support for BTS sleep.

config BT_POWER
	tristate "BCM4334 Bluetooth Power Control"
	depends on RFKILL
	default y
	help
	  Provides a parameter to switch on/off power from PMIC
	  to Bluetooth device.
endmenu
```

## kernel/drivers/huawei/drivers/connectivity/gps/Kconfig
```kconfig
menu "GPS BCM 4752 Driver"   
                                             
comment "GPS BCM 4752 Driver"

config GPS_BCM_4752
        tristate "GPS Boardcom(4752) Driver Support"
        default y
        ---help---
	  Say Y here to compile support for gps devices into the kernel 
	  or say M to compile it as module.  
endmenu
```

## kernel/drivers/huawei/drivers/lcd_panel/Kconfig
```kconfig
config LCD_JDI_OTM1282B
        tristate "JDI_OTM1282B 720p LCD support"
        help
          JDI 720p LCD support, please choose it.

config LCD_CMI_OTM1282B
        tristate "CMI_OTM1282B 720p LCD support"
        help
          JDI 720p LCD support, please choose it.

config LCD_JDI_OTM1902B
        tristate "JDI_OTM1902B 1080p LCD support"
        help
          JDI 1080p LCD support, please choose it.

config TPS65132
        tristate "TPS65132 support"
        help
          TPS65132 support, please choose it.

config LCD_SAMSUNG_LMS350DF04
       tristate "SAMSUNG_LMS350DF04 480x320 LCD support"
       help
         Samsung 480x320 LCD support, please choose it.

config LCD_TOSHIBA_MDW70
       tristate "TOSHIBA_MDW70 720p LCD support"
       help
         Toshiba 720p LCD support, please choose it.

config LCD_TOSHIBA_MDY90
	tristate "TOSHIBA_MDY90 1080p LCD support"
	help
	  Toshiba 1080p LCD support,
	  please choose it.
```

## kernel/drivers/huawei/drivers/led/Kconfig
```kconfig
config LEDS_K3_6421
	bool "LEDS_K3_6421 Trigger"
	depends on LEDS_TRIGGERS && LEDS_TRIGGER_TIMER
	default n
	help
	  This allows LEDs to be controlled by K3 leds activity.
	  If unsure, say n.
```

## kernel/drivers/huawei/drivers/modem/Kconfig
```kconfig
config MODEM_BOOT
       bool "Modem boot control support"
       default y
       help
         Modem boot control support

config MODEM_BOOT_QSC6085
        bool "qsc6085 boot control support"
        depends on MODEM_BOOT
        default y
        help
          Modem qsc6085 boot control support
```

## kernel/drivers/huawei/drivers/power/Kconfig
```kconfig
config BATTERY_BQ27510
        tristate "BATTERY BQ27510"
        depends on I2C_DESIGNWARE

config CHARGER_BQ2419x
        tristate "CHARGER BQ2419x"
        depends on I2C_DESIGNWARE

config BQ_BCI_BATTERY
        tristate "BQ BCI BATTERY"
        depends on BATTERY_BQ27510
        depends on CHARGER_BQ2419x

config BATTERY_HISI_SMARTSTAR
        tristate "BATTERY HISI SMARTSTAR"

config BATTERY_HISI_COUL
        tristate "BATTERY HISI COUL"
```

## kernel/drivers/huawei/drivers/sensor/Kconfig
```kconfig
#sensor unification for differ platform
config HUAWEI_SENSORS_INPUT_INFO
	bool "huawei sensor input info"
	default n
	help
		get the huawei sensor input information.


source "drivers/huawei/drivers/sensor/accelerometer/Kconfig"

source "drivers/huawei/drivers/sensor/compass/Kconfig"

source "drivers/huawei/drivers/sensor/light/Kconfig"

source "drivers/huawei/drivers/sensor/gyroscope/Kconfig"

source "drivers/huawei/drivers/sensor/captouch/Kconfig"

source "drivers/huawei/drivers/sensor/hall/Kconfig"
```

## kernel/drivers/huawei/drivers/sensor/captouch/Kconfig
```kconfig
#
# compass driver configuration
#
menuconfig INPUT_CAPTOUCH
	bool "CAPTOUCH"
	select HUAWEI_SENSORS_INPUT_INFO
	default y
	help
		Say Y here, and a list of supported COMPASSs will be displayed.
		This option doesn't affect the kernel.



if INPUT_CAPTOUCH

config HUAWEI_FEATURE_SENSORS_AD7146
	tristate "AD7146"
	default y
	depends on I2C
	help
		If you say yes here you get support for Asahi Kasei's
		orientation sensor AD7146.


endif
```

## kernel/drivers/huawei/drivers/sensor/hall/Kconfig
```kconfig
#
# hall sensor driver configuration
#
menuconfig INPUT_HALL_SENSOR
	bool "hall sensor"
	select HUAWEI_SENSORS_INPUT_INFO
	default y
	help
		Say Y here, and a list of supported hall sensors will be displayed.
		This option doesn't affect the kernel.


if INPUT_HALL_SENSOR

config HUAWEI_FEATURE_AK8789
	tristate "ak8789_hall"
	default y
	help
	  If you say yes here you get support for light hall ak8789.
endif
```

## kernel/drivers/huawei/drivers/simcard_switch/Kconfig
```kconfig
config SIM_CARD_SWITCH
    tristate "Modem Contrl Driver"
	default y
	help
		Say Y to enable Modem Contrl Support
```

## kernel/drivers/huawei/drivers/touchscreen/Kconfig
```kconfig
#menu "Rmi device drivers"
#source "drivers/huawei/drivers/touchscreen/rmi/Kconfig"
#endmenu

#@menu "Cypress device drivers"
#source "drivers/huawei/drivers/touchscreen/cypress/Kconfig"
#endmenu

menu "Cypress device drivers"
source "drivers/huawei/drivers/touchscreen/ts/Kconfig"
endmenu
```
