## kernel/drivers/huawei/drivers/touchscreen/ts/Kconfig
```kconfig
#
# huawei touchscreen driver configuration
#

config HUAWEI_FEATURE_TS
	bool "huawei touchscreen"
	default y
	help
	  If you say yes here you get support for huawei touchscreen.
	  
config HUAWEI_FEATURE_TS_TEST
	bool "huawei touchscreen test"
	default n
	help
	  If you say yes here you get support for huawei touchscreen.
	  
source "drivers/huawei/drivers/touchscreen/ts/panel/Kconfig"
```

## kernel/drivers/huawei/drivers/touchscreen/ts/panel/Kconfig
```kconfig
config TOUCHSCREEN_SYNAPTICS
	tristate "touchscreen synaptics driver"
	default y
	
config TOUCHSCREEN_CYPRESS
	tristate "touchscreen cypress driver"
	default y
     
```

## kernel/drivers/media/video/hi6620/capture/Kconfig
```kconfig
if VIDEO_HI6620_CAMERA

menu "Hisilicon K3 sock Camera/V4L2 Features support"
config VIDEO_HIK3_ISP_CAMERA
	tristate "Hisilicon K3 ISP"
	depends on VIDEO_HI6620_CAMERA
	default m
    ---help---
        Hisilicon K3 ISP driver.

config CAMERA_WAIT_COMPLT_TIMEOUT
    int "commond set done wait timeout"
    default 1000
    ---help---
        set isp commond set done wait time

config CAMERA_SENSOR_I2C_WAIT_TIMEOUT
    int "sensor I2C wait timeout"
    default 0
    ---help---
        set sensor i2c write wait time

config CAMERA_WAIT_DQBUF_IRQ_TIMEOUT
    int "data queue irq done wait timeout"
    default 2
    ---help---
        set isp dqbuf irq done wait time

config OV_ISP_CLK
    int "ov isp clock frequence"
    default 160000000
    ---help---
        set ov isp clock frequence

config OV_ISP_MIPI_CLK
    int "ov isp mipi clock frequence"
    default 160000000
    ---help---
        set ov isp mipi clock frequence

config CAMERA_WAIT_FOCUS_TIMEOUT
    int "wait focus schedule timeout"
    default 100
    ---help---
        set isp focus schedule wait time

config CAMERA_SCENE_NIGHT_MODE_FPS
    int "scene night mode fps"
    default 1
    ---help---
        set isp scene night mode fps

config ISP_DDR_BLOCK_PROFILE
    int "isp ddr block profile frequence"
    default 533000
    ---help---
        set isp ddr block profile frequence

endmenu

endif
```

## kernel/drivers/media/video/hi6620/fake_capture/Kconfig
```kconfig
if VIDEO_HI6620_CAMERA

menu "Hisilicon K3 sock Camera/V4L2 Features support"
config VIDEO_HIK3_FAKE_CAMERA
	tristate "Hisilicon K3 FAKE CAMERA"
	depends on VIDEO_HI6620_CAMERA
	default m
    ---help---
        Hisilicon K3 Fake Camera driver.

endmenu

endif
```

## kernel/drivers/media/video/hi6620/vpp/Kconfig
```kconfig
config VIDEO_HI6620_VPP
    tristate "vpp driver"
    default n
    ---help---
        This is the vpp driver

config VPP_CLK
    int "VPP Clock Frequence"
    default "140000000"
    help
        Set default vpp clock frequence

config VPP_WAIT_TIMEOUT_COEFF
    int "VPP wait timeout coefficient"
    default "1"
    help
        Set default vpp wait timeout coefficient
```

## kernel/drivers/media_mntn/Kconfig
```kconfig
#
# Video configuration
#

menu "media mntn"

config MEDIA_VIDEO_MNTN
	tristate
	default y
	help
	  This module adds support for mntn

endmenu
```

## kernel/drivers/misc/gpu_drv/Kconfig
```kconfig
#test for V_GPU
menuconfig V_GPU
    bool "Vivante GPU Support"

if V_GPU

config G2D 
    bool "G2D Support"

config G3D 
    bool "G3D Support"
    
config G2D_CLK_RATE
	int "G2D Clock Frequence"
	default "60000000"
	help
	  Set default G2D clock frequence
	  
config G2D_K3
    bool "K3 TESTCHIP POWER"

endif
```

## kernel/drivers/usb/susb300a/Kconfig
```kconfig
#
# USB Dual Role (OTG-ready) Controller Drivers
# based on Synopsys designs
#
config USB_SUSB_300A
	depends on (USB || USB_GADGET)
	tristate 'Synopsys Highspeed Dual Role Controller '
	help
	  Say Y here if your system has a dual role high speed USB
	  controller based on the Synopsys OTG IP.
```

## kernel/drivers/video/hdmi/sii9244/Kconfig
```kconfig
#
# HDMI to MHL device configuration
#

menu "MHL sii9244 support"


config HUAWEI_MHL_SII9244
	tristate "HUAWEI_MHL_SII9244"
	default n
	help
	  If you say yes here you get support for the MHL_Sii9244 transimitter.
	  This driver can also be built as a module.  If so, the module
	  will be called sii9244.

config MHL_USB_SHARE
	tristate "MHL_USB_SHARE"
	default y
	help
	  If you say yes here you get support for the MHL_Sii9244 transimitter.
	  This driver can also be built as a module.  If so, the module
	  will be called sii9244.

endmenu
```

## kernel/sound/soc/hisilicon/Kconfig
```kconfig
menu "SoC Audio support for Hisilicon"

config SND_SOC_PCM_HI3620
	tristate "SoC Audio support for HI3620"
	help
		Enable this option for HI3620 I2S audio support.

config SND_HI3620_HI6421
	tristate "Hi3620-Hi6421 sound support"
	help
		This option enables sound support for Hi3620-Hi6421

config SND_SOC_PCM_HI6620
	tristate "SoC Audio support for HI6620"
	help
		Enable this option for HI6620 I2S audio support.

config SND_HI6620_HI6421
	tristate "Hi6620-Hi6421 sound support"
	help
		This option enables sound support for Hi6620-Hi6421

config SND_HI6620_HI6401
	tristate "Hi6620-Hi6401 sound support"
	help
		This option enables sound support for Hi6620-Hi6421

config SND_ASP
	tristate "Hi6620 ASP support"
	help
		This option enables sound support for hi6620-aspdigital

config SND_TEST_AUDIO_PCM_LOOP
	tristate "Audio LOOP Test support"
	help
		This option enables Test of Audio PCM stream without HIFI
		As there is no HIFI, so we simulate the response of HIFI.

endmenu
```
